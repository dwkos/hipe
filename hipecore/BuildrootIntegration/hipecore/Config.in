## hipecore/BuildrootIntegration/hipecore/Config.in
```kconfig
config BR2_PACKAGE_HIPECORE
	bool "hipecore"
	depends on !BR2_STATIC_LIBS
	depends on BR2_PACKAGE_QT5_JSCORE_AVAILABLE
	depends on BR2_INSTALL_LIBSTDCPP # leveldb
	depends on BR2_HOST_GCC_AT_LEAST_4_9 # icu, host-ruby
	depends on BR2_TOOLCHAIN_GCC_AT_LEAST_4_9 # icu
	depends on BR2_TOOLCHAIN_HAS_THREADS # leveldb
	depends on !BR2_BINFMT_FLAT # icu
	# assumes a FPU is available on MIPS
	depends on !BR2_MIPS_SOFT_FLOAT
	select BR2_PACKAGE_GSTREAMER1
	select BR2_PACKAGE_GST1_PLUGINS_BASE
	select BR2_PACKAGE_ICU
	select BR2_PACKAGE_JPEG
	select BR2_PACKAGE_LEVELDB
	select BR2_PACKAGE_LIBPNG
	select BR2_PACKAGE_OPENSSL
	# Only openssl is supported by qt5
	select BR2_PACKAGE_OPENSSL_FORCE_LIBOPENSSL
	select BR2_PACKAGE_QT5BASE_ICU
	select BR2_PACKAGE_QT5BASE_GUI
	select BR2_PACKAGE_QT5BASE_WIDGETS
	select BR2_PACKAGE_QT5SENSORS
	select BR2_PACKAGE_LIBEXECINFO if !BR2_TOOLCHAIN_USES_GLIBC
	select BR2_PACKAGE_LIBXML2
	select BR2_PACKAGE_LIBXSLT
	select BR2_PACKAGE_WEBP
	select BR2_PACKAGE_WEBP_DEMUX
	select BR2_PACKAGE_WOFF2
	select BR2_PACKAGE_XLIB_LIBXCOMPOSITE if BR2_PACKAGE_QT5BASE_XCB
	select BR2_PACKAGE_XLIB_LIBXEXT if BR2_PACKAGE_QT5BASE_XCB
	select BR2_PACKAGE_XLIB_LIBXRENDER if BR2_PACKAGE_QT5BASE_XCB
	help
	  HipeCore is a stripped down distribution of QtWebKit
	  that has been optimised for use with the Hipe display server.


comment "hipecore needs a toolchain w/ dynamic library, gcc >= 4.9, host gcc >= 4.9"
	depends on BR2_STATIC_LIBS || !BR2_TOOLCHAIN_GCC_AT_LEAST_4_9 || \
		!BR2_HOST_GCC_AT_LEAST_4_9
	depends on BR2_PACKAGE_QT5_JSCORE_AVAILABLE
	depends on !BR2_BINFMT_FLAT
	depends on !BR2_MIPS_SOFT_FLOAT
```
